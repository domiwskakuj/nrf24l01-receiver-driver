/dts-v1/;
/plugin/;
/ {
        compatible = "brcm,bcm2835", "brcm,bcm2708", "brcm,bcm2709";

        fragment@0 {
                target = <&spi0>;
                __overlay__ {
                        status = "okay";
                };
        };
	fragment@1 {
		target = <&spidev0>;
		__overlay__ {
			status = "disabled";
		};
	};
        fragment@2 {
                target = <&spi0>;
                __overlay__ {
			#address-cells = <1>;
			#size-cells = <0>;
			nrf24@0 {
				reg = <0>;
				compatible = "domi,nrf24", "nrf24";
				pinctrl-names = "default";
				spi-max-frequency = <1000000>;
				gpio-ce = <&gpio 14 0>;
				/* gpio-irq = <&gpio 25 0>; */
			};
                };
        };

};
